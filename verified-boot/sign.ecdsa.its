## verified-boot/sign.ecdsa.its
```
/dts-v1/;

/ {
	description = "vexpress board";
	#address-cells = <1>;

	images {
		kernel {
			data = /incbin/("Image.lzo");
			type = "kernel";
			arch = "arm";
			os = "linux";
			compression = "lzo";
			load = <0x80008000>;
			entry = <0x80008000>;
			hash-1 {
				algo = "sha384";
			};
		};
		fdt-1 {
			description = "vexpress board";
			data = /incbin/("vexpress-v2p-ca9.dtb");
			type = "flat_dt";
			arch = "arm";
			compression = "none";
			hash-1 {
				algo = "sha384";
			};
		};
	};
	configurations {
		default = "conf-1";
		conf-1 {
			kernel = "kernel";
			fdt = "fdt-1";
			signature {
				algo = "sha384,ecdsa256";
				key-name-hint = "ec-secp256k1-priv-key";
				sign-images = "fdt", "kernel";
			};
		};
	};
};
```

## verified-boot/sign.rsa.its
```
/dts-v1/;

/ {
	description = "vexpress board";
	#address-cells = <1>;

	images {
		kernel {
			data = /incbin/("Image.lzo");
			type = "kernel";
			arch = "arm";
			os = "linux";
			compression = "lzo";
			load = <0x80008000>;
			entry = <0x80008000>;
			hash-1 {
				algo = "sha1";
			};
		};
		fdt-1 {
			description = "vexpress board";
			data = /incbin/("vexpress-v2p-ca9.dtb");
			type = "flat_dt";
			arch = "arm";
			compression = "none";
			hash-1 {
				algo = "sha1";
			};
		};
	};
	configurations {
		default = "conf-1";
		conf-1 {
			kernel = "kernel";
			fdt = "fdt-1";
			signature-1 {
				algo = "sha1,rsa2048";
				key-name-hint = "dev";
				sign-images = "fdt", "kernel";
			};
		};
	};
};
```
